/*
Copyright (c) 2022:Shanghai TOSUN Technology Ltd.

The software mentioned in this copyright statement includes the automatic code generator function module of TSMaster software and the embedded code it generates. Among them, the copyright of the automatic code generation function module of TSMaster software is owned by Shanghai TOSUN Technology Ltd..It is protected by the Copyright Law of the People's Republic of China, the Regulations on the Protection of Computer Software, the Intellectual Property Protection Law, the Patent Law of the People's Republic of China and relevant international copyright treaties, laws, regulations, and other intellectual property laws and treaties. 

The embedded code generated by the automatic code generation function of the TSMaster is a non-commercial code whose copyright belongs to Shanghai TOSUN Technology Ltd. or the original copyright owner of the embedded code, and is only for personal learning and use. Shanghai TOSUN Technology Ltd. does not provide any kind of warranty, whether express or implied. All risks are borne by the user, and Shanghai TOSUN Technology Ltd. does not assume any joint responsibility.

The semiconductor manufacturer's LOGO and product model displayed in the TSMaster are only for the convenience of user selection and useage,its copyright and ownership remain with the respective copyright owners,Shanghai TOSUN Technology Ltd. does not provide any guarantee and rights guarantee for this, and does not assume joint and several liability for any possible infringement.

Shanghai TOSUN Technology Ltd. reserves the right to modify and upgrade the software mentioned in this copyright statement without notifying users, and reserves the right to modify this license agreement.
*/
#include "FIFOQUEUE.h"
#include "mcu_lock.h"
/*Queue Init*/
uint8_t
QueueInit(struct FifoQueue* Queue, ElemType* dat, uint16_t queue_size)
{
	uint8_t ret = (0==1);
	Queue->queue_size = queue_size;
	Queue->dat = dat;
	if ((Queue->dat != (ElemType*)0)
		&& (Queue->queue_size != 0)
		)
	{
		Queue->front = 0;
		Queue->rear = 0;;
		Queue->count = 0;
		ret = (1 == 1);
	}
	return ret;
}

/* Queue In */
uint8_t
QueueIn (register struct FifoQueue *Queue, ElemType sdat)
{
	register volatile cpu_status_t cpu_sr;
	MCU_LOCK_ENTER_CRITICAL;
    if ((Queue->front == Queue->rear) && (Queue->count == Queue->queue_size))
    {
		MCU_LOCK_EXIT_CRITICAL;
        return QueueFull;
    }
    else
    {
        Queue->dat[Queue->rear] = sdat;
        Queue->rear = (Queue->rear + 1) % Queue->queue_size;
        Queue->count = Queue->count + 1;
		MCU_LOCK_EXIT_CRITICAL;
        return QueueOperateOk;
    }
}

/* Queue Out*/
uint8_t
QueueOut (register struct FifoQueue * Queue, ElemType * sdat)
{
	register volatile cpu_status_t cpu_sr;
	MCU_LOCK_ENTER_CRITICAL;
    if ((Queue->front == Queue->rear) && (Queue->count == 0))
    {
		MCU_LOCK_EXIT_CRITICAL;
        return QueueEmpty;
    }
    else
    {
        *sdat = Queue->dat[Queue->front];
        Queue->front = (Queue->front + 1) % Queue->queue_size;
        Queue->count = Queue->count - 1;
		MCU_LOCK_EXIT_CRITICAL;
        return QueueOperateOk;
    }
}
