/*
Written by A2lUpdate v1.0.0.0
11/9/2024 5:29 PM
Original file: FG9322_XCP_A2L.a2l
*/ ASAP2_VERSION 1 61
/begin PROJECT ASAM "_default_Project"
/begin HEADER "default_Header" PROJECT_NO ASAM2013 /end HEADER
/begin MODULE Module_01 "default_Module"
/begin MOD_PAR "default_ModPar" EPK "EPROM_ID_01" ADDR_EPK 0x100100FF
 /begin MEMORY_SEGMENT MemorySegment_01 "MemorySegment_01" DATA FLASH EXTERN 0x1000FFFF 0xF0000 -1 -1 -1 -1 -1 /begin IF_DATA ETK_XETK ADDRESS_MAPPING 0x80810000 0xa3010000 0xf0000 /end IF_DATA /end MEMORY_SEGMENT
/end MOD_PAR
/begin MOD_COMMON "default_ModCommon" BYTE_ORDER MSB_FIRST DEPOSIT ABSOLUTE ALIGNMENT_BYTE 1 ALIGNMENT_WORD 2 ALIGNMENT_LONG 4 ALIGNMENT_FLOAT32_IEEE 4 ALIGNMENT_FLOAT64_IEEE 8 ALIGNMENT_INT64 8 /end MOD_COMMON
/begin IF_DATA XCP
 /begin PROTOCOL_LAYER 0x100 2000 2000 2000 65535 2000 5 5 0x8 0x8 BYTE_ORDER_MSB_LAST ADDRESS_GRANULARITY_BYTE SEED_AND_KEY_EXTERNAL_FUNCTION "SeedNKeyXcp.dll" /end PROTOCOL_LAYER
 /begin DAQ STATIC 0x6 0x6 0x0 OPTIMISATION_TYPE_DEFAULT ADDRESS_EXTENSION_FREE IDENTIFICATION_FIELD_TYPE_ABSOLUTE GRANULARITY_ODT_ENTRY_SIZE_DAQ_0 0x0 OVERLOAD_INDICATION_NotSet
  /begin DAQ_LIST 0 DAQ_LIST_TYPE DAQ MAX_ODT 2 MAX_ODT_ENTRIES 7 EVENT_FIXED 0 FIRST_PID 0x0 /end DAQ_LIST
  /begin DAQ_LIST 1 DAQ_LIST_TYPE DAQ MAX_ODT 2 MAX_ODT_ENTRIES 7 EVENT_FIXED 1 FIRST_PID 0x2 /end DAQ_LIST
  /begin DAQ_LIST 2 DAQ_LIST_TYPE DAQ MAX_ODT 2 MAX_ODT_ENTRIES 7 EVENT_FIXED 2 FIRST_PID 0x4 /end DAQ_LIST
  /begin DAQ_LIST 3 DAQ_LIST_TYPE DAQ MAX_ODT 2 MAX_ODT_ENTRIES 7 EVENT_FIXED 3 FIRST_PID 0x6 /end DAQ_LIST
  /begin DAQ_LIST 5 DAQ_LIST_TYPE DAQ MAX_ODT 15 MAX_ODT_ENTRIES 7 EVENT_FIXED 5 FIRST_PID 0x8 /end DAQ_LIST
  /begin DAQ_LIST 4 DAQ_LIST_TYPE DAQ MAX_ODT 15 MAX_ODT_ENTRIES 7 EVENT_FIXED 4 FIRST_PID 0x17 /end DAQ_LIST
  /begin EVENT "Segment 1" "Segment 1" 0 DAQ 1 0 0 0 /end EVENT
  /begin EVENT "Segment 2" "Segment 2" 1 DAQ 1 0 0 0 /end EVENT
  /begin EVENT "Segment 3" "Segment 3" 2 DAQ 1 0 0 0 /end EVENT
  /begin EVENT "Segment 4" "Segment 4" 3 DAQ 1 0 0 0 /end EVENT
  /begin EVENT "Tim100ms" "Tim100ms" 5 DAQ 1 1 8 0 /end EVENT
  /begin EVENT "Time 10ms" "Time 10ms" 4 DAQ 1 1 7 0 /end EVENT
 /end DAQ
/end IF_DATA
/begin COMPU_METHOD CompuMethod_01 "" RAT_FUNC "%2.2" "-" COEFFS 0 1 0 0 0 2 /end COMPU_METHOD
/begin COMPU_METHOD CompuMethod_02 "" TAB_VERB "%2.2" "-" COMPU_TAB_REF CompuVtab_01 /end COMPU_METHOD
/begin COMPU_METHOD CompuMethod_03 "RATIONALFUNCTION_[0;1;0;0;0;1]" RAT_FUNC "%2.2" "-" COEFFS 0 1 0 0 0 1 /end COMPU_METHOD
/begin COMPU_METHOD CompuMethod_04 "RATIONALFUNCTION_[0;1;0;0;0;0.02]" RAT_FUNC "%2.2" "s" COEFFS 0 1 0 0 0 0.02 /end COMPU_METHOD
/begin COMPU_METHOD CompuMethod_05 "RATIONALFUNCTION_[0;1;0;0;0;0.1]" RAT_FUNC "%2.2" "%" COEFFS 0 1 0 0 0 0.0025 /end COMPU_METHOD
/begin COMPU_METHOD CompuMethod_06 "" RAT_FUNC "%2.2" "rpm" COEFFS 0 4 0 0 0 1 /end COMPU_METHOD
/begin COMPU_METHOD CompuMethod_07 "RATIONALFUNCTION_[0;1;0;0;0;0.205]" RAT_FUNC "%2.2" "U/min" COEFFS 0 1 0 0 0 0.205 /end COMPU_METHOD
/begin COMPU_METHOD CompuMethod_08 "" RAT_FUNC "%2.2" "V" COEFFS 0 819 0 0 0 1 /end COMPU_METHOD
/begin COMPU_METHOD CompuMethod_09 "" RAT_FUNC "%4.4" "bar" COEFFS 0 100 0 0 0 1 /end COMPU_METHOD
/begin COMPU_VTAB CompuVtab_01 "" TAB_VERB 2 0 "FALSE" 1 "TRUE" /end COMPU_VTAB
/begin FUNCTION Function_01 "FunctionList_01" FUNCTION_VERSION "2.2" /begin DEF_CHARACTERISTIC /end DEF_CHARACTERISTIC
 /begin CHARACTERISTIC OS_CPU_Load "CPU load measurement" VALUE 0x200109d4 CURVE_AXIS "NO_AXIS_PTS" ECU_ADDRESS 0x200109d4 RECORD_LAYOUT "DEFAULT_RECORD_LAYOUT" MAX_DIFF 1 FORMAT "%5.3" DISPLAY_IDENTIFIER "OS_CPU_Load" UNIT "%" /end CHARACTERISTIC
 /begin OUT_MEASUREMENT /end OUT_MEASUREMENT
 /begin IN_MEASUREMENT /end IN_MEASUREMENT
 /begin LOC_MEASUREMENT
  /begin MEASUREMENT OS_CPU_Load "CPU load measurement" UBYTE 0x200109d4 0 100 ECU_ADDRESS 0x200109d4 FORMAT "%5.3" DISPLAY_IDENTIFIER "OS_CPU_Load" UNIT "%" /end MEASUREMENT
 /end LOC_MEASUREMENT
/end FUNCTION
/end MODULE
/end PROJECT
