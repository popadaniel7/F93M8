/*
A2L file compatible with CCP, including only the OS_CPU_Load variable.
*/ ASAP2_VERSION 1 61
/begin PROJECT ASAM "_default_Project"
/begin HEADER "default_Header" PROJECT_NO ASAM2013 /end HEADER
/begin MODULE Module_01 "default_Module"
/begin MOD_PAR "default_ModPar" EPK "EPROM_ID_01" ADDR_EPK 0x100100FF /end MOD_PAR
/begin MOD_COMMON "default_ModCommon" BYTE_ORDER MSB_FIRST DEPOSIT ABSOLUTE ALIGNMENT_BYTE 1 /end MOD_COMMON
/begin CHARACTERISTIC OS_CPU_Load "CPU load measurement" VALUE 0x200109d4 NO_AXIS_PTS ECU_ADDRESS 0x200109d4 RECORD_LAYOUT "DEFAULT_RECORD_LAYOUT" FORMAT "%5.3" UNIT "%" /end CHARACTERISTIC
/begin MEASUREMENT OS_CPU_Load "CPU load measurement" UBYTE 0x200109d4 0 100 FORMAT "%5.3" UNIT "%" /end MEASUREMENT
/end MODULE
/end PROJECT
